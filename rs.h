/*
* Reed Solomon Encoder/Decoder
*
* Copyright Henry Minsky (hqm@alum.mit.edu) 1991-2009
*
* This software library is licensed under terms of the GNU GENERAL
* PUBLIC LICENSE
*
* RSCODE is free software: you can redistribute it and/or modify
* it under the terms of the GNU General Public License as published by
* the Free Software Foundation, either version 3 of the License, or
* (at your option) any later version.
*
* RSCODE is distributed in the hope that it will be useful,
* but WITHOUT ANY WARRANTY; without even the implied warranty of
* MERCHANTABILITY or FITNESS FOR A PARTICULAR PURPOSE.  See the
* GNU General Public License for more details.
*
* You should have received a copy of the GNU General Public License
* along with Rscode.  If not, see <http://www.gnu.org/licenses/>.

* Commercial licensing is available under a separate license, please
* contact author for details.
*
* Source code is available at http://rscode.sourceforge.net
*/

#include <stdio.h>
#include <ctype.h>

/* Number of parity bytes */
#define NPAR 8

/* Maximum degree of various polynomials. */
#define MAXDEG ((NPAR)*2)

#define GEXP(x) pgm_read_byte_far(&gexp[(x)])
#define GLOG(x) pgm_read_byte_far(&glog[(x)])
#define RSCODE_PROGMEM PROGMEM

const byte gexp[512] = {
	0x01, 0x02, 0x04, 0x08, 0x10, 0x20, 0x40, 0x80, 0x1d, 0x3a, 0x74, 0xe8, 0xcd, 0x87, 0x13, 0x26,
	0x4c, 0x98, 0x2d, 0x5a, 0xb4, 0x75, 0xea, 0xc9, 0x8f, 0x03, 0x06, 0x0c, 0x18, 0x30, 0x60, 0xc0,
	0x9d, 0x27, 0x4e, 0x9c, 0x25, 0x4a, 0x94, 0x35, 0x6a, 0xd4, 0xb5, 0x77, 0xee, 0xc1, 0x9f, 0x23,
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	0x58, 0xb0, 0x7d, 0xfa, 0xe9, 0xcf, 0x83, 0x1b, 0x36, 0x6c, 0xd8, 0xad, 0x47, 0x8e, 0x01, 0x00 };

const byte glog[256] = {
	0x00, 0x00, 0x01, 0x19, 0x02, 0x32, 0x1a, 0xc6, 0x03, 0xdf, 0x33, 0xee, 0x1b, 0x68, 0xc7, 0x4b,
	0x04, 0x64, 0xe0, 0x0e, 0x34, 0x8d, 0xef, 0x81, 0x1c, 0xc1, 0x69, 0xf8, 0xc8, 0x08, 0x4c, 0x71,
	0x05, 0x8a, 0x65, 0x2f, 0xe1, 0x24, 0x0f, 0x21, 0x35, 0x93, 0x8e, 0xda, 0xf0, 0x12, 0x82, 0x45,
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	0x4f, 0xae, 0xd5, 0xe9, 0xe6, 0xe7, 0xad, 0xe8, 0x74, 0xd6, 0xf4, 0xea, 0xa8, 0x50, 0x58, 0xaf };

/* generator polynomial */
const byte genPoly[NPAR + 1] = { 0x25, 0xe0, 0x08, 0xac, 0x47, 0xb2, 0x2c, 0xe3, 0x01 };

/* Decoder syndrome bytes */
int synBytes[MAXDEG];

/* multiplication using logarithms */
byte gmult(byte a, byte b)
{
	if (a == 0 || b == 0) return (0);
	return (GEXP(GLOG(a) + GLOG(b)));
}

/**********************************************************
* Reed Solomon Decoder
*
* Computes the syndrome of a codeword. Puts the results
* into the synBytes[] array.
*/

void
decode_data(volatile uint8_t data[], int nbytes)
{
	int i, j, sum;
	for (j = 0; j < NPAR; j++) {
		sum = 0;
		for (i = 0; i < nbytes; i++) {
			sum = data[i] ^ gmult(gexp[j + 1], sum);
		}
		synBytes[j] = sum;
	}
}

/**********************************************************
* Error correction
*/

/* Check if the syndrome is zero */
int check_syndrome(void) {
	int i, nz = 0;
	for (i = 0; i < NPAR; i++) {
		if (synBytes[i] != 0) {
			nz = 1;
			break;
		}
	}
	return nz;
}

/* The Error Locator Polynomial, also known as Lambda or Sigma. Lambda[0] == 1 */
static int Lambda[MAXDEG];

/* The Error Evaluator Polynomial */
static int Omega[MAXDEG];

/* local ANSI declarations */
static int compute_discrepancy(int lambda[], int S[], int L, int n);
static void init_gamma(int gamma[]);
static void compute_modified_omega(void);
static void mul_z_poly(int src[]);

/* error locations found using Chien's search*/
static int ErrorLocs[256];
static int NErrors;

/* erasure flags */
static int ErasureLocs[256];
static int NErasures;

/********** polynomial arithmetic *******************/

void add_polys(int dst[], int src[]) {
	int i;
	for (i = 0; i < MAXDEG; i++) dst[i] ^= src[i];
}

void copy_poly(int dst[], int src[]) {
	int i;
	for (i = 0; i < MAXDEG; i++) dst[i] = src[i];
}

void scale_poly(int k, int poly[]) {
	int i;
	for (i = 0; i < MAXDEG; i++) poly[i] = gmult(k, poly[i]);
}


void zero_poly(int poly[]) {
	int i;
	for (i = 0; i < MAXDEG; i++) poly[i] = 0;
}

/* polynomial multiplication */
void mult_polys(int dst[], int p1[], int p2[]) {
	int i, j;
	int tmp1[MAXDEG * 2];

	for (i = 0; i < (MAXDEG * 2); i++) dst[i] = 0;

	for (i = 0; i < MAXDEG; i++) {
		for (j = MAXDEG; j < (MAXDEG * 2); j++) tmp1[j] = 0;

		/* scale tmp1 by p1[i] */
		for (j = 0; j < MAXDEG; j++) tmp1[j] = gmult(p2[j], p1[i]);
		/* and mult (shift) tmp1 right by i */
		for (j = (MAXDEG * 2) - 1; j >= i; j--) tmp1[j] = tmp1[j - i];
		for (j = 0; j < i; j++) tmp1[j] = 0;

		/* add into partial product */
		for (j = 0; j < (MAXDEG * 2); j++) dst[j] ^= tmp1[j];
	}
}

/* multiply by z, i.e., shift right by 1 */
static void mul_z_poly(int src[]) {
	int i;
	for (i = MAXDEG - 1; i > 0; i--) src[i] = src[i - 1];
	src[0] = 0;
}

int ginv(int elt) {
	return (gexp[255 - glog[elt]]);
}

/* Finds all the roots of an error-locator polynomial with coefficients
* Lambda[j] by evaluating Lambda at successive values of alpha.
*
* This can be tested with the decoder's equations case.
*/
void Find_Roots(void) {
	int sum, r, k;
	NErrors = 0;

	for (r = 1; r < 256; r++) {
		sum = 0;
		/* evaluate lambda at r */
		for (k = 0; k < NPAR + 1; k++) {
			sum ^= gmult(gexp[(k*r) % 255], Lambda[k]);
		}
		if (sum == 0)
		{
			ErrorLocs[NErrors] = (255 - r); NErrors++;
		}
	}
}

/* From  Cain, Clark, "Error-Correction Coding For Digital Communications", pp. 216. */
void Modified_Berlekamp_Massey(void) {
	int n, L, L2, k, d, i;
	int psi[MAXDEG], psi2[MAXDEG], D[MAXDEG];
	int gamma[MAXDEG];

	/* initialize Gamma, the erasure locator polynomial */
	init_gamma(gamma);

	/* initialize to z */
	copy_poly(D, gamma);
	mul_z_poly(D);

	copy_poly(psi, gamma);
	k = -1; L = NErasures;

	for (n = NErasures; n < NPAR; n++) {
		d = compute_discrepancy(psi, synBytes, L, n);

		if (d != 0) {
			/* psi2 = psi - d*D */
			for (i = 0; i < MAXDEG; i++)
				psi2[i] = psi[i] ^ gmult(d, D[i]);

			if (L < (n - k)) {
				L2 = n - k;
				k = n - L;
				/* D = scale_poly(ginv(d), psi); */
				for (i = 0; i < MAXDEG; i++) D[i] = gmult(psi[i], ginv(d));
				L = L2;
			}
			/* psi = psi2 */
			for (i = 0; i < MAXDEG; i++) psi[i] = psi2[i];
		}
		mul_z_poly(D);
	}
	for (i = 0; i < MAXDEG; i++)
		Lambda[i] = psi[i];

	compute_modified_omega();
}

/* given Psi (called Lambda in Modified_Berlekamp_Massey) and synBytes,
compute the combined erasure/error evaluator polynomial as
Psi*S mod z^4
*/
void compute_modified_omega() {
	int i;
	int product[MAXDEG * 2];

	mult_polys(product, Lambda, synBytes);
	zero_poly(Omega);
	for (i = 0; i < NPAR; i++) Omega[i] = product[i];

}

/* gamma = product (1-z*a^Ij) for erasure locs Ij */
void init_gamma(int gamma[]) {
	int e, tmp[MAXDEG];

	zero_poly(gamma);
	zero_poly(tmp);
	gamma[0] = 1;

	for (e = 0; e < NErasures; e++) {
		copy_poly(tmp, gamma);
		scale_poly(gexp[ErasureLocs[e]], tmp);
		mul_z_poly(tmp);
		add_polys(gamma, tmp);
	}
}

void compute_next_omega(int d, int A[], int dst[], int src[]) {
	int i;
	for (i = 0; i < MAXDEG; i++) {
		dst[i] = src[i] ^ gmult(d, A[i]);
	}
}

int compute_discrepancy(int lambda[], int S[], int L, int n) {
	int i, sum = 0;

	for (i = 0; i <= L; i++)
		sum ^= gmult(lambda[i], S[n - i]);
	return (sum);
}

/* Combined Erasure And Error Magnitude Computation
*
* Pass in the codeword, its size in bytes, as well as
* an array of any known erasure locations, along the number
* of these erasures.
*
* Evaluate Omega(actually Psi)/Lambda' at the roots
* alpha^(-i) for error locs i.
*
* Returns true if everything ok, or false if an out-of-bounds error is found
*
*/
bool correct_errors_erasures(volatile uint8_t codeword[], int csize, int nerasures, int erasures[]) {
	int r, i, j, err;

	/* If you want to take advantage of erasure correction, be sure to
	set NErasures and ErasureLocs[] with the locations of erasures.
	*/
	NErasures = nerasures;
	for (i = 0; i < NErasures; i++) ErasureLocs[i] = erasures[i];

	Modified_Berlekamp_Massey();
	Find_Roots();

	if ((NErrors <= NPAR) && NErrors > 0) {
		/* first check for illegal error locs */
		for (r = 0; r < NErrors; r++) {
			if (ErrorLocs[r] >= csize) {
				return(false);
			}
		}

		for (r = 0; r < NErrors; r++) {
			int num, denom;
			i = ErrorLocs[r];
			/* evaluate Omega at alpha^(-i) */

			num = 0;
			for (j = 0; j < MAXDEG; j++)
				num ^= gmult(Omega[j], gexp[((255 - i)*j) % 255]);

			/* evaluate Lambda' (derivative) at alpha^(-i) ; all odd powers disappear */
			denom = 0;
			for (j = 1; j < MAXDEG; j += 2) {
				denom ^= gmult(Lambda[j], gexp[((255 - i)*(j - 1)) % 255]);
			}

			err = gmult(num, ginv(denom));

			codeword[csize - i - 1] ^= err;
		}
		return(true);
	}
	else {
		return(false);
	}
}